## config/boards/shields/charybdis/Kconfig.defconfig
```kconfig
if SHIELD_CHARYBDIS_LEFT || SHIELD_CHARYBDIS_RIGHT

config ZMK_KEYBOARD_NAME
	default "Charybdis"

# Enable split mode with Bluetooth
config ZMK_SPLIT
	default y

endif

if SHIELD_CHARYBDIS_RIGHT

# Right side is central - connects to computer via USB and to left via BLE
config ZMK_SPLIT_BLE_ROLE_CENTRAL
	default y

endif
```
